## main/Kconfig.projbuild
```kconfig
menu "HMI Device Configuration"

    choice HMI_LCD_CONTROLLER
        prompt "LCD controller model"
        default HMI_LCD_CONTROLLER_ST7796
        help
            Select LCD controller model

        config HMI_LCD_CONTROLLER_ILI9341
            bool "ILI9341"

        config HMI_LCD_CONTROLLER_GC9A01
            bool "GC9A01"

        config HMI_LCD_CONTROLLER_ST7796
            bool "ST7796"
            help
                TFT controller ST7796 with SPI interface.
       
            config HMI_LCD_CONTROLLER_ST7796P8
            bool "ST7796P8"            
            help
                TFT controller ST7796 with 8bit Parellel interface.
    endchoice

    config HMI_LCD_TOUCH_ENABLED
        bool "Enable LCD touch"
        default n
        help
            Enable this option if you wish to use display touch. You can select from touch controllers.

    choice HMI_LCD_TOUCH_CONTROLLER
        prompt "LCD touch controller model"
        depends on HMI_LCD_TOUCH_ENABLED
        default HMI_LCD_TOUCH_CONTROLLER_FT5X06
        help
            Select LCD touch controller model

        config HMI_LCD_TOUCH_CONTROLLER_STMPE610
            bool "STMPE610"
            help
                Touch controller STMPE610 connected via SPI.
        config HMI_LCD_TOUCH_CONTROLLER_FT5X06
            bool "FT5X06"
            help
                Touch controller FT5X06 connected via I2C.
        
    endchoice

endmenu
```

## sdkconfig.defaults
```kconfig
CONFIG_LV_USE_USER_DATA=y
CONFIG_LV_COLOR_16_SWAP=y
CONFIG_LV_COLOR_DEPTH_16=y

#CONFIG_HMI_LCD_CONTROLLER_ST7796=y
CONFIG_HMI_LCD_TOUCH_ENABLED=y
CONFIG_HMI_LCD_TOUCH_CONTROLLER_FT5X06=y

CONFIG_ESP_DEFAULT_CPU_FREQ_MHZ_240=y
CONFIG_ESP_DEFAULT_CPU_FREQ_MHZ=240
CONFIG_ESPTOOLPY_FLASHSIZE_4MB=y
CONFIG_ESPTOOLPY_FLASHSIZE="4MB"

#CONFIG_COMPILER_OPTIMIZATION_PERF=y
#CONFIG_LV_ATTRIBUTE_FAST_MEM_USE_IRAM=y
#CONFIG_LV_MEMCPY_MEMSET_STD=y

#
# ESP PSRAM
#
CONFIG_SPIRAM=y

#
# SPI RAM config
#
CONFIG_SPIRAM_MODE_QUAD=y
CONFIG_SPIRAM_TYPE_AUTO=y
CONFIG_SPIRAM_SPEED_40M=y
CONFIG_SPIRAM_SPEED=40
CONFIG_SPIRAM_BOOT_INIT=y
CONFIG_SPIRAM_USE_MALLOC=y
CONFIG_SPIRAM_MEMTEST=y
CONFIG_SPIRAM_MALLOC_ALWAYSINTERNAL=16384
CONFIG_SPIRAM_MALLOC_RESERVE_INTERNAL=32768
CONFIG_SPIRAM_CACHE_WORKAROUND=y
```
